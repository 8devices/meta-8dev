// SPDX-License-Identifier: GPL-2.0
/*
 * Copyright (c) 2025 8devices, UAB
 */

#include "qcs404.dtsi"

&soc {
	sdcc2: mmc@7844000 {
		compatible = "qcom,qcs404-sdhci", "qcom,sdhci-msm-v5";
		reg = <0x7844000 0x1000>;
		reg-names = "hc";

		interrupts = <GIC_SPI 125 IRQ_TYPE_LEVEL_HIGH>,
			     <GIC_SPI 221 IRQ_TYPE_LEVEL_HIGH>;
		interrupt-names = "hc_irq", "pwr_irq";

		clocks = <&gcc GCC_SDCC2_AHB_CLK>,
			 <&gcc GCC_SDCC2_APPS_CLK>,
			 <&xo_board>;
		clock-names = "iface", "core", "xo";

		status = "disabled";
	};

	/*
	 * qcs404.dtsi describes no interrupt, so qcom-wdt cannot offer a
	 * pretimeout and a hang is a silent reset. Every mainline SoC that
	 * declares one for this block puts the bark on SPI 3 -- ipq5332,
	 * ipq6018, ipq8074, ipq9574, sm6115, qcm2290, msm8994 -- and the two
	 * that declare both use SPI 4 for the bite, which qcom-wdt never
	 * claims: the hardware resets on it regardless.
	 *
	 * Claiming the bark alone changes behaviour: probe sets
	 * wdd.pretimeout = 1, so it lands a second ahead of the bite even with
	 * nothing configured. Whether that panics or just logs is soc.cfg's
	 * call.
	 */
	watchdog@b017000 {
		interrupts = <GIC_SPI 3 IRQ_TYPE_EDGE_RISING>;
	};
};
