// SPDX-License-Identifier: GPL-2.0
/*
 * Copyright (c) 2025 8devices, UAB
 */

/dts-v1/;

#include "qcs405-8devices-tobufi-dvk.dts"

/ {
	/* IOT (0x20) TobuFi-DVK (0x81) HWrev (3.0) */
	qcom,board-id = <0x81000320 0x0>;
};
