// SPDX-License-Identifier: BSD-3-Clause
/*
 * Mainline CAMSS + libcamera pipeline for robovision, which breaks out CSI0 and
 * CSI1 only.
 */

/dts-v1/;
/plugin/;

#include <dt-bindings/clock/qcom,camcc-sc7280.h>
#include <dt-bindings/gpio/gpio.h>

#include "qcs6490-citron-camss.dtsi"
