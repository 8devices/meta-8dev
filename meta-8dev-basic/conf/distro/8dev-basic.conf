## meta-8dev-basic/conf/distro/include/camera-stack-camss.inc
```bitbake
DISTRO_FEATURES:append = " camss"

CAMERA_KERNEL_FEATURE = "bsp/qcs6490/camss.scc"
CAMERA_DTBO = "camss"
FEATURE_PACKAGES_camera = "packagegroup-video-streaming-camss"
```

## meta-8dev-basic/conf/distro/include/camera-stack-camx.inc
```bitbake
DISTRO_FEATURES:append = " camx"

CAMERA_KERNEL_FEATURE = "bsp/qcs6490/camx.scc"
CAMERA_DTBO = "camx"
FEATURE_PACKAGES_camera = "packagegroup-video-streaming-camx"
```

## meta-8dev-basic/conf/layer.conf
```bitbake
BBPATH .= ":${LAYERDIR}"

BBFILES += "${LAYERDIR}/recipes-*/*/*.bb \
            ${LAYERDIR}/recipes-*/*/*.bbappend"

BBFILE_COLLECTIONS += "8dev-basic"
BBFILE_PATTERN_8dev-basic = "^${LAYERDIR}/"
BBFILE_PRIORITY_8dev-basic = "6"

LAYERDEPENDS_8dev-basic = "core networking-layer openembedded-layer multimedia-layer qcom swupdate"
LAYERSERIES_COMPAT_8dev-basic = "wrynose"
```

## meta-8dev-basic/recipes-support/swupdate/files/defconfig
```kconfig
#
# SWUpdate Settings
#

#
# General Configuration
#
CONFIG_SYSTEMD=y
CONFIG_DEFAULT_CONFIG_FILE="/etc/swupdate.cfg"
CONFIG_SCRIPTS=y
CONFIG_HW_COMPATIBILITY=y
CONFIG_HW_COMPATIBILITY_FILE="/etc/hwrevision"
CONFIG_SW_VERSIONS_FILE="/etc/sw-versions"

#
# Socket Paths
#
CONFIG_SOCKET_CTRL_PATH="/var/run/swupdate_ctrl.sock"
CONFIG_SOCKET_PROGRESS_PATH="/var/run/swupdate_prog.sock"
# end of Socket Paths

# CONFIG_MTD is not set
# CONFIG_LUA is not set
# end of General Configuration

#
# Build Options
#
CONFIG_CROSS_COMPILE=""
CONFIG_SYSROOT=""
CONFIG_EXTRA_LDLIBS=""
# end of Build Options

#
# Debugging Options
#
# CONFIG_DEBUG is not set
# CONFIG_WERROR is not set
# CONFIG_NOCLEANUP is not set
# end of Debugging Options
# end of SWUpdate Settings

#
# Bootloader support
#

#
# Bootloader Interfaces
#
CONFIG_BOOTLOADER_NONE=y
# CONFIG_BOOTLOADER_EBG is not set
# CONFIG_UBOOT is not set
# CONFIG_BOOTLOADER_GRUB is not set
# CONFIG_BOOTLOADER_CBOOT is not set
# end of Bootloader Interfaces

CONFIG_BOOTLOADER_DEFAULT_NONE=y
# CONFIG_BOOTLOADER_STATIC_LINKED is not set
CONFIG_UPDATE_STATE_CHOICE_BOOTLOADER=y
CONFIG_UPDATE_STATE_BOOTLOADER="ustate"

#
# Interfaces
#
# CONFIG_DOWNLOAD is not set
# CONFIG_SURICATTA is not set
# CONFIG_WEBSERVER is not set

#
# Security
#
CONFIG_SSL_IMPL_NONE=y
# CONFIG_SSL_IMPL_OPENSSL is not set
# CONFIG_SSL_IMPL_WOLFSSL is not set
# CONFIG_SSL_IMPL_MBEDTLS is not set

#
# Hash checking needs an SSL implementation
#

#
# Image signature verification needs an SSL implementation
#

#
# Image encryption needs an SSL implementation
#

#
# Compressors (zlib always on)
#
CONFIG_GUNZIP=y
# CONFIG_ZSTD is not set

#
# Parsers
#

#
# Parser Features
#
CONFIG_LIBCONFIG=y
CONFIG_PARSERROOT=""
# CONFIG_SETSWDESCRIPTION is not set
# end of Parser Features

#
# Handlers
#

#
# Image Handlers
#
# CONFIG_ARCHIVE is not set
# CONFIG_BOOTLOADERHANDLER is not set
# CONFIG_COPY is not set
# CONFIG_DELTA is not set
# CONFIG_DISKPART is not set
# CONFIG_DISKFORMAT_HANDLER is not set
# CONFIG_EMMC_HANDLER is not set
CONFIG_RAW=y
# CONFIG_RDIFFHANDLER is not set
# CONFIG_REMOTE_HANDLER is not set
CONFIG_SHELLSCRIPTHANDLER=y
# CONFIG_SWUFORWARDER_HANDLER is not set
# CONFIG_UCFWHANDLER is not set
# CONFIG_UNIQUEUUID is not set
# end of Image Handlers

#
# Containers
#

#
# Update containers
#
# CONFIG_DOCKER is not set
# end of Update containers
```

## meta-8dev-bsp/conf/layer.conf
```bitbake
BBPATH .= ":${LAYERDIR}"

BBFILES += "${LAYERDIR}/recipes-*/*/*.bb \
            ${LAYERDIR}/recipes-*/*/*.bbappend"

BBFILE_COLLECTIONS += "8dev-bsp"
BBFILE_PATTERN_8dev-bsp = "^${LAYERDIR}/"
BBFILE_PRIORITY_8dev-bsp = "6"

LAYERDEPENDS_8dev-bsp = "core openembedded-layer qcom"
LAYERSERIES_COMPAT_8dev-bsp = "wrynose"
```

## meta-8dev-bsp/conf/machine/include/qcom-qcs40x.inc
```bitbake
SOC_FAMILY ?= "qcs40x"
require conf/machine/include/qcom-common.inc

DEFAULTTUNE ?= "cortexa53"
include conf/machine/include/arm/armv8a/tune-cortexa53.inc

MACHINE_ESSENTIAL_EXTRA_RRECOMMENDS += " \
    qrtr \
"
```

## meta-8dev-bsp/conf/machine/include/qcom/qcs40x.inc
```bitbake
SOC_FAMILY ?= "qcs40x"
include conf/machine/include/soc-family.inc

DEFAULTTUNE ?= "cortexa53"
include conf/machine/include/arm/armv8a/tune-cortexa53.inc
```

## meta-8dev-bsp/recipes-kernel/linux/linux-yocto/files/Documentation/devicetree/bindings/thermal/virtual-thermal-zone.yaml
```yaml
# SPDX-License-Identifier: (GPL-2.0)
# Based on:
# - Documentation/devicetree/bindings/thermal/thermal-zones.yaml (kernel 6.6), Copyright (c) 2020 Linaro Ltd. Amit Kucheria <amitk@kernel.org>
# Copyright (c) 2025 8devices UAB
%YAML 1.2
---
$id: http://devicetree.org/schemas/thermal/virtual-thermal-zone.yaml#
$schema: http://devicetree.org/meta-schemas/core.yaml#

title: Generic Virtual Thermal Zones

maintainers:
  - Giedrė Šimkūnaitė <giedre.s@8devices.com>

description: |
  The Generic Virtual Thermal Zones driver provides support for creating
  virtual thermal zones that aggregate temperatures from one or more physical
  thermal zones using configurable calculation methods (max, min, average, median, etc.).

  For single-source zones, the driver uses direct pass-through (no calculation)
  by default, making it useful for adding trip points and cooling policies to
  existing thermal zones without modifying the original zone definition.

  For multiple-source zones, temperatures are aggregated using the specified
  calculation method (defaulting to 'max').

  The driver automatically scans the device tree for nodes with
  compatible = "virtual-thermal-zone" within the thermal-zones node.
  No separate platform device node is required - the driver creates its
  own platform device and automatically discovers all virtual thermal zone
  definitions.

properties:
  compatible:
    const: virtual-thermal-zone

  source-thermal-zones:
    $ref: /schemas/types.yaml#/definitions/string-array
    description: |
      Array of thermal zone names to aggregate. The driver will look up these
      thermal zones by name and read their temperatures.
    minItems: 1
    maxItems: 32

  calculate:
    $ref: /schemas/types.yaml#/definitions/string
    description: |
      Temperature calculation method to use when multiple source thermal zones
      are specified. Defines how multiple sensor readings are combined into a
      single virtual temperature.

      Default behavior:
      - Single source (1 zone): No calculate property needed - driver automatically
        uses direct pass-through with no temperature calculations.
      - Multiple sources (2+ zones): Defaults to 'max' if not specified

      Note: This property is ignored for single-source zones. The driver will
      always use direct pass-through (no calculations) when only one source
      thermal zone is specified.

      Available calculation methods for multiple sources:
      - max: Maximum temperature of all sources (default)
      - min: Minimum temperature of all sources
      - average: Arithmetic mean of all sources
      - median: Median value of all sources
      - mean: Same as average
      - weighted-average: Weighted average (currently equal weights)
      - rolling-average: Moving average over last 5 readings
      - exponential-average: Exponential moving average (alpha=0.3)
    enum:
      - max
      - min
      - average
      - median
      - mean
      - weighted-average
      - rolling-average
      - exponential-average

  polling-delay-passive:
    $ref: /schemas/types.yaml#/definitions/uint32
    description: |
      Polling interval in milliseconds when any trip point is active.
      If not specified, defaults to 100 ms.

  polling-delay:
    $ref: /schemas/types.yaml#/definitions/uint32
    description: |
      Polling interval in milliseconds when no trip points are active.
      If not specified, defaults to 1000 ms.

  sustainable-power:
    $ref: /schemas/types.yaml#/definitions/uint32
    description: |
      Sustainable power in milliwatts for the power allocator governor.

  coefficients:
    $ref: /schemas/types.yaml#/definitions/uint32-array
    description: |
      Thermal coefficients [slope, offset] for temperature calculation.
    minItems: 2
    maxItems: 2

  thermal-governor:
    $ref: /schemas/types.yaml#/definitions/string
    description: |
      Name of the thermal governor to use for this zone.
    enum:
      - step_wise
      - fair_share
      - bang_bang
      - user_space
      - power_allocator

  trips:
    type: object
    description: |
      Trip points for the virtual thermal zone.
      Maximum 64 trip points supported (limited by thermal subsystem bitmask).
    patternProperties:
      "^[a-zA-Z0-9\\-_]+$":
        type: object
        properties:
          temperature:
            $ref: /schemas/types.yaml#/definitions/uint32
            description: Trip temperature in millidegree Celsius.

          hysteresis:
            $ref: /schemas/types.yaml#/definitions/uint32
            description: Hysteresis value in millidegree Celsius.

          type:
            $ref: /schemas/types.yaml#/definitions/string
            description: Trip point type.
            enum:
              - active
              - passive
              - hot
              - critical

        required:
          - temperature
          - hysteresis
          - type

        additionalProperties: false

  cooling-maps:
    type: object
    description: |
      Cooling device mappings for trip points.
    patternProperties:
      "^map[0-9]+$":
        type: object
        properties:
          trip:
            $ref: /schemas/types.yaml#/definitions/phandle
            description: Reference to a trip point.

          cooling-device:
            $ref: /schemas/types.yaml#/definitions/phandle-array
            description: |
              List of cooling devices with min/max cooling states.

          contribution:
            $ref: /schemas/types.yaml#/definitions/uint32
            description: |
              Cooling contribution weight for power allocator governor.

        required:
          - trip
          - cooling-device

        additionalProperties: false

required:
  - compatible
  - source-thermal-zones

additionalProperties: false

examples:
  - |
    // Virtual thermal zone definitions
    thermal-zones {
        cpuss-max-step {
            compatible = "virtual-thermal-zone";
            source-thermal-zones = "cluster0-thermal", "cluster1-thermal",
                                   "cpu0-thermal", "cpu1-thermal";
            calculate = "max";
            polling-delay-passive = <100>;
            polling-delay = <1000>;
            sustainable-power = <1000>;
            coefficients = <1 0>;
            thermal-governor = "step_wise";

            trips {
                cpuss_passive: cpuss-passive {
                    temperature = <75000>;
                    hysteresis = <5000>;
                    type = "passive";
                };

                cpuss_hot: cpuss-hot {
                    temperature = <85000>;
                    hysteresis = <5000>;
                    type = "hot";
                };

                cpuss_critical: cpuss-critical {
                    temperature = <95000>;
                    hysteresis = <0>;
                    type = "critical";
                };
            };

            cooling-maps {
                map0 {
                    trip = <&cpuss_passive>;
                    cooling-device = <&CPU0 0 4>;
                    contribution = <1024>;
                };

                map1 {
                    trip = <&cpuss_hot>;
                    cooling-device = <&CPU0 4 8>;
                    contribution = <2048>;
                };
            };
        };

        gpu-average {
            compatible = "virtual-thermal-zone";
            source-thermal-zones = "gpu0-thermal", "gpu1-thermal";
            calculate = "average";
            polling-delay-passive = <50>;
            polling-delay = <500>;
            thermal-governor = "power_allocator";

            trips {
                gpu_passive: gpu-passive {
                    temperature = <70000>;
                    hysteresis = <3000>;
                    type = "passive";
                };
            };

            cooling-maps {
                map0 {
                    trip = <&gpu_passive>;
                    cooling-device = <&gpu 0 10>;
                };
            };
        };

        // Single-source virtual zone with implicit 'none' calculation method
        // Useful for adding cooling policies to existing thermal zones
        // without modifying the original zone definition
        wifi-virtual {
            compatible = "virtual-thermal-zone";
            source-thermal-zones = "wifi-thermal";
            // calculate defaults to 'none' for single source
            polling-delay-passive = <100>;
            polling-delay = <1000>;
            thermal-governor = "step_wise";

            trips {
                wifi_alert: wifi-alert {
                    temperature = <80000>;
                    hysteresis = <5000>;
                    type = "passive";
                };
            };

            cooling-maps {
                map0 {
                    trip = <&wifi_alert>;
                    cooling-device = <&wifi_cooling 0 3>;
                };
            };
        };
    };
```
